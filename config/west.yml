## config/west.yml
```yaml
manifest:
  remotes:
    - name: zmkfirmware
      url-base: https://github.com/nickconway
  projects:
    - name: zmk
      remote: zmkfirmware
      revision: dynamic-macro
      import: app/west.yml
  self:
    path: config
```
